## main/Kconfig
```kconfig
menu "Cloud OTA Configuration"

    config WIFI_SSID
        string "WiFi SSID"
        default "Spider"
        help
            SSID of the WiFi network to connect to.

    config WIFI_PASSWORD
        string "WiFi Password"
        default "S147@369s"
        help
            Password of the WiFi network.

    config CDN_SERVER_VERSION_URL
        string "CDN Server Version URL"
        default "https://d2bpgfntnplhed.cloudfront.net/version.txt"
        help
            URL for fetching the plain-text version descriptor from CloudFront CDN.

    config CDN_SERVER_FIRMWARE_URL
        string "CDN Server Firmware URL"
        default "https://d2bpgfntnplhed.cloudfront.net/firmware.bin"
        help
            URL for fetching the firmware binary from CloudFront CDN.

    config OTA_POLLING_INTERVAL_SEC
        int "OTA Polling Interval (seconds)"
        default 30
        range 5 86400
        help
            Frequency in seconds at which the device polls the CloudFront CDN for version updates.
            Default is 30 seconds (ideal for testing). Increase for production deployments.

endmenu
```
